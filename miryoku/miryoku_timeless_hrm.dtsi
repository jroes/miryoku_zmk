/ {
  behaviors {
    u_hrm_l: u_hrm_l {
      compatible = "zmk,behavior-hold-tap";
      #binding-cells = <2>;
      bindings = <&kp>, <&kp>;
      flavor = "balanced";
      tapping-term-ms = <HM_TAPPING_TERM>;
      quick-tap-ms = <HM_QUICK_TAP>;
      require-prior-idle-ms = <HM_PRIOR_IDLE>;
      hold-trigger-key-positions = <KEYS_RIGHT THUMBS>;
      hold-trigger-on-release;
    };
    u_hrm_r: u_hrm_r {
      compatible = "zmk,behavior-hold-tap";
      #binding-cells = <2>;
      bindings = <&kp>, <&kp>;
      flavor = "balanced";
      tapping-term-ms = <HM_TAPPING_TERM>;
      quick-tap-ms = <HM_QUICK_TAP>;
      require-prior-idle-ms = <HM_PRIOR_IDLE>;
      hold-trigger-key-positions = <KEYS_LEFT THUMBS>;
      hold-trigger-on-release;
    };
  };
};